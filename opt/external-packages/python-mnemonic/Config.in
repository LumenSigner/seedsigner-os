## opt/external-packages/python-mnemonic/Config.in
```kconfig
config BR2_PACKAGE_PYTHON_MNEMONIC
	bool "python-mnemonic"
	help
	  Implementation of Bitcoin BIP-0039.

	  https://github.com/trezor/python-mnemonic
```

## opt/external-packages/python-stellar-sdk-mini/Config.in
```kconfig
config BR2_PACKAGE_PYTHON_STELLAR_SDK_MINI
	bool "python-stellar-sdk-mini"
	select BR2_PACKAGE_PYTHON_CFFI # runtime
	select BR2_PACKAGE_PYTHON_MNEMONIC # runtime
	select BR2_PACKAGE_PYTHON_PYCPARSER # runtime
	select BR2_PACKAGE_PYTHON_PYNACL # runtime
	help
	  The Python Stellar SDK library provides APIs to build
	  transactions and connect to Horizon.

	  https://github.com/StellarCN/py-stellar-base
```

## opt/pi0-dev/Config.in
```kconfig
source "../external-packages/python-pyzbar/Config.in"
source "../external-packages/python-mock/Config.in"
source "../external-packages/python-embit/Config.in"
source "../external-packages/python-picamera/Config.in"
source "../external-packages/python-qrcode/Config.in" 
source "../external-packages/python-mnemonic/Config.in"
source "../external-packages/python-stellar-sdk-mini/Config.in"
```
